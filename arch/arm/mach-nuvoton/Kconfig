## arch/arm/mach-nuvoton/Kconfig
```kconfig
if ARCH_NUVOTON

config SYS_SOC
	default "nuvoton"

config SYS_VENDOR
	default "nuvoton"

config NUA3500
	select ARM64
	select DM
	select DM_ETH
	bool "Nuvoton NUA3500"
	default y

source "arch/arm/mach-nuvoton/nua3500/Kconfig"
source "board/nuvoton/nua3500/Kconfig"

endif
```

## arch/arm/mach-nuvoton/nua3500/Kconfig
```kconfig
if NUA3500

choice
	prompt  "Nuvoton NUA3500 board select"
	optional

config TARGET_NUA3500_EVB
	bool "NUA3500 EVB"

config TARGET_NUA3500_IOT
	bool "NUA3500 IoT Board"

endchoice

endif
```

## board/nuvoton/nua3500/Kconfig
```kconfig
if NUA3500

config SYS_BOARD
	default "nua3500"

config SYS_VENDOR
	default "nuvoton"

config SYS_CONFIG_NAME
	default "nua3500"

endif
```

## cmd/nuvoton/Kconfig
```kconfig
menu "Nuvoton specific command line interface"

config CMD_NU_AES
	bool "Enable the command for AES decrypt image"
	depends on NUA3500_CRYPTO
	help
	   Support decrypt the kernel image with Nuvoton
	   NUA3500 on-chip cryptographic accelerator. 

endmenu
```

## configs/nua3500_defconfig
```kconfig
CONFIG_ARM=y
CONFIG_POSITION_INDEPENDENT=y
CONFIG_ARCH_NUVOTON=y
CONFIG_SYS_TEXT_BASE=0x80E00000
CONFIG_SYS_MALLOC_F_LEN=0x4000
CONFIG_TARGET_NUA3500=y
CONFIG_NR_DRAM_BANKS=1
CONFIG_ARMV8_SET_SMPEN=y
CONFIG_BOOTDELAY=0
CONFIG_BOARD_LATE_INIT=y
CONFIG_SYS_PROMPT="NUA3500> "
CONFIG_DEFAULT_DEVICE_TREE="nua3500"
CONFIG_SPECIFY_CONSOLE_INDEX=y
CONFIG_CONS_INDEX=0
CONFIG_DM_SERIAL=y
CONFIG_BAUDRATE=9600

CONFIG_PINCTRL=y
CONFIG_PINCTRL_FULL=y
CONFIG_PINCTRL_GENERIC=y
CONFIG_PINMUX=y
CONFIG_PINCONF_RECURSIVE=y
CONFIG_PINCTRL_NUA3500=y

CONFIG_DM=y
CONFIG_DM_WARN=y
CONFIG_DM_DEVICE_REMOVE=y
CONFIG_DM_STDIO=y
CONFIG_DM_SEQ_ALIAS=y
CONFIG_REGMAP=y
CONFIG_SYSCON=y
CONFIG_SIMPLE_BUS=y
CONFIG_OF_TRANSLATE=y
CONFIG_DM_DEV_READ_INLINE=y

CONFIG_CLK=y
CONFIG_CLK_CCF=y
CONFIG_NUA3500_CLK_CCF=y

CONFIG_HAVE_BLOCK_DEVICE=y

CONFIG_SPI=y
CONFIG_DM_SPI=y
CONFIG_SPI_MEM=y
CONFIG_NUA3500_SPI=y

CONFIG_MTD_PARTITIONS=y
CONFIG_MTD=y
CONFIG_DM_MTD=y
CONFIG_MTD_NAND_CORE=y
CONFIG_MTD_SPI_NAND=y

CONFIG_DM_SPI_FLASH=y
CONFIG_SPI_FLASH=y
CONFIG_SF_DEFAULT_BUS=0
CONFIG_SF_DEFAULT_CS=0
CONFIG_SF_DEFAULT_MODE=3
CONFIG_SF_DEFAULT_SPEED=1000000
CONFIG_SPI_FLASH_BAR=y
CONFIG_SPI_FLASH_ATMEL=y
CONFIG_SPI_FLASH_EON=y
CONFIG_SPI_FLASH_GIGADEVICE=y
CONFIG_SPI_FLASH_ISSI=y
CONFIG_SPI_FLASH_MACRONIX=y
CONFIG_SPI_FLASH_SPANSION=y
CONFIG_SPI_FLASH_STMICRO=y
CONFIG_SPI_FLASH_SST=y
CONFIG_SPI_FLASH_WINBOND=y
CONFIG_SPI_FLASH_XMC=y
CONFIG_SPI_FLASH_USE_4K_SECTORS=y
CONFIG_SPI_FLASH_MTD=y
```

## drivers/crypto/Kconfig
```kconfig
menu "Hardware crypto devices"

config NUA3500_CRYPTO
	bool "Nuvoton NUA3500 cryptographic accelerator."
	depends on NUA3500
	default y
	help
	  Enables support for the on-chip cryptographic accelerator on NUA3500.

source drivers/crypto/fsl/Kconfig

endmenu
```

## drivers/pinctrl/nuvoton/Kconfig
```kconfig
config PINCTRL_NUA3500
	bool "NUVOTON NUA3500 pin control drivers"
	depends on PINCTRL_GENERIC
	default y
	help
	  Enable support pin control functions for NVT SoCs.

config SPL_PINCTRL_NUA3500
	bool "Support NUVOTON NUA3500 pin controllers in SPL"
	depends on SPL_PINCTRL_GENERIC
	default y
	help
	  This option is an SPL-variant of the PINCTRL_NVT option.
```
