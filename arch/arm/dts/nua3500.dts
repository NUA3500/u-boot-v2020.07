// SPDX-License-Identifier:
/*
 * Copyright 2020 - Nuvoton Technology Corporation
 *
 */

/dts-v1/;
#include "nua3500.dtsi"

/ {
	model = "Nuvoton NUA3500 EVB board";
	compatible = "nuvoton,nua3500";

	aliases {

	};

	memory {
		device_type = "memory";
		reg = <0x00000000 0x80000000 0 0x10000000>;
	};

};

&uart0 {
	status = "okay";
};





